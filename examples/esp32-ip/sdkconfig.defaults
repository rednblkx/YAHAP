## examples/esp32-ip/sdkconfig.defaults
```kconfig
CONFIG_ESPTOOLPY_FLASHMODE_QIO=y
CONFIG_ESPTOOLPY_FLASHSIZE_8MB=y
CONFIG_PARTITION_TABLE_CUSTOM=y
CONFIG_COMPILER_OPTIMIZATION_SIZE=y
CONFIG_COMPILER_OPTIMIZATION_ASSERTIONS_SILENT=y
CONFIG_ESP_ERR_TO_NAME_LOOKUP=n
CONFIG_PM_ENABLE=y
CONFIG_PM_DFS_INIT_AUTO=y
CONFIG_ESP_MAIN_TASK_STACK_SIZE=16384
CONFIG_FREERTOS_USE_TICKLESS_IDLE=y
CONFIG_LOG_VERSION_2=y
CONFIG_MBEDTLS_ERROR_STRINGS=n
```

## examples/esp32/sdkconfig.defaults
```kconfig
CONFIG_ESPTOOLPY_FLASHMODE_QIO=y
CONFIG_ESPTOOLPY_FLASHSIZE_4MB=y
CONFIG_PARTITION_TABLE_CUSTOM=y
CONFIG_COMPILER_OPTIMIZATION_SIZE=y
CONFIG_COMPILER_OPTIMIZATION_ASSERTIONS_SILENT=y
CONFIG_COMPILER_ASSERT_NDEBUG_EVALUATE=y
CONFIG_COMPILER_DISABLE_DEFAULT_ERRORS=y
CONFIG_COMPILER_ORPHAN_SECTIONS_WARNING=y
CONFIG_BT_ENABLED=y
CONFIG_BT_NIMBLE_ENABLED=y
CONFIG_BT_NIMBLE_HOST_TASK_STACK_SIZE=16384
CONFIG_BT_NIMBLE_HOST_ALLOW_CONNECT_WITH_SCAN=y
CONFIG_BT_NIMBLE_HOST_QUEUE_CONG_CHECK=y
CONFIG_BT_NIMBLE_ENC_ADV_DATA=y
CONFIG_BT_NIMBLE_OPTIMIZE_MULTI_CONN=y
CONFIG_PM_ENABLE=y
CONFIG_ESP_MAIN_TASK_STACK_SIZE=8192
CONFIG_ESP_WIFI_MBEDTLS_TLS_CLIENT=n
CONFIG_WIFI_RMT_MBEDTLS_TLS_CLIENT=n
CONFIG_FATFS_LFN_NONE=y
CONFIG_FATFS_USE_DYN_BUFFERS=n
CONFIG_FREERTOS_USE_TICKLESS_IDLE=y
CONFIG_FREERTOS_IN_IRAM=y
CONFIG_LOG_VERSION_2=y
CONFIG_MBEDTLS_THREADING_C=n
CONFIG_MBEDTLS_DYNAMIC_BUFFER=y
CONFIG_MBEDTLS_DYNAMIC_FREE_CONFIG_DATA=y
CONFIG_MBEDTLS_PEM_WRITE_C=n
CONFIG_MBEDTLS_X509_CRL_PARSE_C=n
CONFIG_MBEDTLS_X509_CSR_PARSE_C=n
CONFIG_MBEDTLS_CERTIFICATE_BUNDLE=n
CONFIG_MBEDTLS_CIPHER_MODE_CFB=n
CONFIG_MBEDTLS_CIPHER_MODE_OFB=n
CONFIG_MBEDTLS_CIPHER_MODE_XTS=n
CONFIG_MBEDTLS_ECP_DP_SECP521R1_ENABLED=n
CONFIG_MBEDTLS_ECP_DP_SECP256K1_ENABLED=n
CONFIG_MBEDTLS_ECP_DP_BP256R1_ENABLED=n
CONFIG_MBEDTLS_ECP_DP_BP384R1_ENABLED=n
CONFIG_MBEDTLS_ECP_DP_BP512R1_ENABLED=n
CONFIG_MBEDTLS_LARGE_KEY_SOFTWARE_MPI=n
CONFIG_ESP_PROTOCOMM_SUPPORT_SECURITY_VERSION_0=y
CONFIG_ESP_PROTOCOMM_SUPPORT_SECURITY_VERSION_1=y
CONFIG_SPI_FLASH_SUPPORT_BOYA_CHIP=y
CONFIG_VFS_SUPPORT_TERMIOS=y
CONFIG_PAL_NETWORK_ENABLED=n
```

## examples/esp32/sdkconfig.defaults.esp32c6
```kconfig
CONFIG_BT_LE_SLEEP_ENABLE=y
CONFIG_USJ_NO_AUTO_LS_ON_CONNECTION=y
CONFIG_ESP_PHY_MAC_BB_PD=y
CONFIG_IEEE802154_ENABLED=n
```
